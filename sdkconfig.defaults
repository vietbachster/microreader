## sdkconfig.defaults
```kconfig
CONFIG_ESPTOOLPY_FLASHSIZE_16MB=y
CONFIG_ESPTOOLPY_FLASHSIZE="16MB"

# Enable FAT Long File Name support (needed for .epub filenames)
CONFIG_FATFS_LFN_HEAP=y

# Main task needs enough stack for EPUB parsing (ZIP + XML + CSS)
CONFIG_ESP_MAIN_TASK_STACK_SIZE=16384

# --- RAM optimizations ---
# Optimize for size (-Os) instead of debug — smaller IRAM footprint
CONFIG_COMPILER_OPTIMIZATION_SIZE=y
CONFIG_COMPILER_OPTIMIZATION_DEBUG=n

# Use newlib nano printf (smaller code, no float support needed)
CONFIG_NEWLIB_NANO_FORMAT=y

# Move WiFi IRAM functions to flash — we don't use WiFi, free ~10KB IRAM→heap
CONFIG_ESP_WIFI_IRAM_OPT=n
CONFIG_ESP_WIFI_RX_IRAM_OPT=n

# Move FreeRTOS functions to flash (slightly slower, saves IRAM)
CONFIG_FREERTOS_PLACE_FUNCTIONS_INTO_FLASH=y

# Use SPI flash ROM implementation (saves IRAM by using ROM code)
CONFIG_SPI_FLASH_ROM_IMPL=y

# Reduce ISR stack (default 1536, we have no heavy ISRs)
CONFIG_FREERTOS_ISR_STACKSIZE=1024
```
